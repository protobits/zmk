/*
 * Copyright (c) 2020 Pete Johanson
 *
 * SPDX-License-Identifier: MIT
 */

#include "goji.dtsi"

&kscan0 {
	col-gpios
		= <&gpio0 0 GPIO_ACTIVE_HIGH>
		, <&gpio0 1 GPIO_ACTIVE_HIGH>
		, <&gpio0 2 GPIO_ACTIVE_HIGH>
		, <&gpio0 3 GPIO_ACTIVE_HIGH>
		, <&gpio0 4 GPIO_ACTIVE_HIGH>
		, <&gpio0 5 GPIO_ACTIVE_HIGH>
		;
};

&usbd {
	status = "okay";
};