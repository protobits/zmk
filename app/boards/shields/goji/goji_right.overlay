/*
 * Copyright (c) 2020 Pete Johanson
 *
 * SPDX-License-Identifier: MIT
 */

#include "goji.dtsi"

&default_transform {
	col-offset = <6>;
};

&kscan0 {
	col-gpios
		= <&gpio0 5 GPIO_ACTIVE_HIGH>
		, <&gpio0 4 GPIO_ACTIVE_HIGH>
		, <&gpio0 3 GPIO_ACTIVE_HIGH>
		, <&gpio0 2 GPIO_ACTIVE_HIGH>
		, <&gpio0 1 GPIO_ACTIVE_HIGH>
		, <&gpio0 0 GPIO_ACTIVE_HIGH>
		;
};
